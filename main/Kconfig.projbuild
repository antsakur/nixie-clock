## main/Kconfig.projbuild
```kconfig
menu "User Configuration"

    choice BOARD
        prompt "Board"
        default ESP32_C6_WROOM_1
        help
            Select board

        config ESP32_C6_WROOM_1
            bool "ESP32_C6_WROOM_1"
        config ESP32_C6_MINI_1
            bool "ESP32_C6_MINI_1"
    endchoice

    config ESP_MAXIMUM_RETRY
        int "Initial connection retry count"
        default 5
        help
            STA disconnects to tolerate before abandoning credentials that
            have not yet received an IP, and before bringing the setup AP
            back after a later disconnect.

    config SNTP_TIME_SERVER
        string "SNTP server"
        default "pool.ntp.org"
        help
            Hostname of the main SNTP server.

    config SNTP_TIME_SERVER_BACKUP
        string "Backup SNTP server"
        default "time.google.com"
        help
            Used when the main SNTP server does not respond.

endmenu
```
